#include "disp.h"
#include "hw.h"

const char font5x7[455] =
   {0x00, 0x00, 0x00, 0x00, 0x00 ,  // sp
    0x00, 0x00, 0x2f, 0x00, 0x00 ,  // !
    0x00, 0x07, 0x00, 0x07, 0x00 ,  // "
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    0x44, 0x64, 0x54, 0x4C, 0x44};  // z 


const char init_vals[46] = {
	0x80,0xae,0x80,0xd5,0x80,0x80,0x80,0xa8,
	0x80,0x1f,0x80,0xd3,0x80,0x00,0x80,0x8d,
	0x80,0x14,0x80,0x40,0x80,0xa6,0x80,0xa4,
	0x80,0xa0,0x80,0xC0,0x80,0xda,0x80,0x12,
	0x80,0x81,0x80,0x8F,0x80,0xd9,0x80,0xf1,
	0x80,0xdb,0x80,0x40,0x80,0xaf
	};


void disp_clr (unsigned char data)
	{
	unsigned char x,y;
	for (y=0;y<4;y++)
		{
		disp_set_xy(0,y);
        iic_start_addr(Write_Address);
		iic_write(0x40);
		for (x=0;x<64;x++)
			iic_write(data);
		iic_stop();
		}	
	}

void disp_char_print (unsigned char data)
{
unsigned char underline,disp_loop_var;
unsigned int temp;
iic_start_addr(Write_Address);
iic_write(0x40);
underline = 0;
if (data&0x80) underline--;		//underflow, so variable underline is 0 or 0xFF here
data = data&0x7F;
if (data<' ') data = ' ';
temp = ((unsigned int)(data - 0x20)*5);
for (disp_loop_var=0;disp_loop_var<5;disp_loop_var++)
	iic_write(font5x7[temp+disp_loop_var] ^underline);
iic_write(underline);	
iic_stop();

}

void disp_puts(char *data)
{
unsigned char counter,eol;
eol = 1;
for (counter=0;counter<10;counter++)
	{
	if (*data==0) eol = 0;
  	if (eol) disp_char_print(*data);
	else disp_char_print(' ');
	*data++;
  	}
}

void disp_set_xy (unsigned char x, unsigned char y)
	{
	x = x + 32;
    y = y + 32;
    iic_start_addr(Write_Address);
	iic_write(0x80);
	iic_write(0xb0|y);	
	iic_write(0x80);
	iic_write(0x10|(x>>4));
	iic_write(0x80);
	iic_write(0x0f&x);
	iic_stop();
	}

void disp_init (void)
	{
	unsigned char i;
//	DISP_PWR=0;
	dly_ms(50);
	DISP_PWR=1;
	dly_ms(200);

//	iic_start();
//	iic_write(Write_Address);
    iic_start_addr(Write_Address);
	for (i=0;i<46;i++)
		iic_write(init_vals[i]);
 	iic_stop();
	
	}

//here is more straightforward version, though consuming more FLASH
//code above is more compact
//left here for reference
/*
void disp_init (void)
	{
	unsigned char Contrast_level=0x8F;
	DISP_PWR=0;
	dly_ms(50);
	DISP_PWR=1;
	dly_ms(200);

	iic_start();
	iic_write(Write_Address);
	iic_write(0x80);
	iic_write(0xae);//--turn off oled panel
	iic_write(0x80);

	iic_write(0xd5);//--set display clock divide ratio/oscillator frequency
	iic_write(0x80);
	iic_write(0x80);//--set divide ratio
	iic_write(0x80);

	iic_write(0xa8);//--set multiplex ratio(1 to 64)
	iic_write(0x80);
	iic_write(0x1f);//--1/32 duty
	iic_write(0x80);

	iic_write(0xd3);//-set display offset
	iic_write(0x80);
	iic_write(0x00);//-not offset
	iic_write(0x80);

	iic_write(0x8d);//--set Charge Pump enable/disable
	iic_write(0x80);
	iic_write(0x14);//--set(0x10) disable
	iic_write(0x80);

	iic_write(0x40);//--set start line address
	iic_write(0x80);

	iic_write(0xa6);//--set normal display
	iic_write(0x80);

	iic_write(0xa4);//Disable Entire Display On
	iic_write(0x80);

	iic_write(0xa0);//--set segment re-map 128 to 0
	iic_write(0x80);

	iic_write(0xC0);//--Set COM Output Scan Direction 64 to 0
	iic_write(0x80);
	
	iic_write(0xda);//--set com pins hardware configuration
	iic_write(0x80);
	iic_write(0x12);
	iic_write(0x80);

	iic_write(0x81);//--set contrast control register
	iic_write(0x80);
	iic_write(0x8F);
	iic_write(0x80);

	iic_write(0xd9);//--set pre-charge period
	iic_write(0x80);
	iic_write(0xf1);
	iic_write(0x80);

	iic_write(0xdb);//--set vcomh
	iic_write(0x80);
	iic_write(0x40);

	iic_write(0x80);

	iic_write(0xaf);//--turn on oled panel

 	iic_stop();
	
	}
*/

